// SPDX-License-Identifier: GPL-2.0-or-later
/* LDD5 Uebung04
 *
 * Bauernfeind, Schmalzer
 * button device tree file
 */
#include "socfpga_cyclone5_de1soc.dts"
/ {
	soc {
		pushbutton: pushbutton@ff200050 {
			compatible = "ldd,pushbutton";
			reg = <0xff200050 0x1>, <0xff200054 0x1>,
			<0xff200058 0x1>, <0xff20005C 0x1>;
			interrupts = <0x0 0x29 0x1>;
			interrupt-parent = <&intc>;
		};
	};
};
